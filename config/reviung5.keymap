/*
 * Copyright (c) 2022 The ZMK Contributors
 *
 * SPDX-License-Identifier: MIT
 */

#include <behaviors.dtsi>
#include <dt-bindings/zmk/keys.h>
#include <dt-bindings/zmk/bt.h>
#include <dt-bindings/zmk/outputs.h>

/ {
        keymap {
            compatible = "zmk,keymap";

            default_layer {
              display-name = "LOH";
              bindings = <
                // ╭─────────────┬──────────────┬──────────────────┬─────────────┬─────────────╮
                     &mo BSPC       &kp L  	  &kp O    	     &kp H         &kp SPACE
                // ╰─────────────┴──────────────┴──────────────────┴─────────────┴─────────────╯
              >;
            };
        };
};
